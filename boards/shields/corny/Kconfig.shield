## boards/shields/corny/Kconfig.shield
```kconfig
# Copyright (c) 2020 Pete Johanson
# SPDX-License-Identifier: MIT

config SHIELD_CORNY_LEFT
	def_bool $(shields_list_contains,corny_left)

config SHIELD_CORNY_RIGHT
	def_bool $(shields_list_contains,corny_right)
```
